## firmware/components/airgrep/Kconfig
```kconfig
menu "airgrep hardware"

    choice AIRGREP_BOARD
        prompt "Controller module"
        default AIRGREP_BOARD_PLUS

        config AIRGREP_BOARD_PLUS
            bool "XIAO ESP32-S3 Plus"
    endchoice

    config AIRGREP_PIN_UART_RX
        int
        default 7 if AIRGREP_BOARD_PLUS

    config AIRGREP_PIN_UART_TX
        int
        default 44 if AIRGREP_BOARD_PLUS

    config AIRGREP_PIN_BUZZER
        int
        default 8 if AIRGREP_BOARD_PLUS

    config AIRGREP_PIN_USR_LED
        int
        default 21 if AIRGREP_BOARD_PLUS
        help
            Active-low user LED lit by the health check, -1 for none.

    config AIRGREP_CPU_METRICS
        bool "Measure the CPU load for the health check"
        default y
        select FREERTOS_GENERATE_RUN_TIME_STATS
        help
            Off leaves the CPU health bit at 0.

    config AIRGREP_PIN_SDA
        int
        default 5

    config AIRGREP_PIN_SCL
        int
        default 6

    config AIRGREP_I2C_TIMEOUT_MS
        int "I2C transaction timeout in ms"
        default 20
        range 1 1000
        help
            Longest wait for one transaction. Actions on the loop do one
            transaction each, so this bounds the action.

endmenu
```

## firmware/components/daidalus/Kconfig
```kconfig
menu "DAIDALUS"
config DAIDALUS_FILE_IO
    bool "Configuration and encounter file I/O"
    default n
    help
        Include file readers, writers and batch processing. The application
        must provide a mounted filesystem for filename-based operations.
        All computational functionality remains available when disabled.
config DAIDALUS_SINGLE_PRECISION
    bool "Compute in single precision"
    default n
    help
        Compute in float instead of double. The ESP32-S3 has a single
        precision FPU and emulates double in software. Results differ from
        the double build within the precision of float.
endmenu
```

## firmware/main/Kconfig.projbuild
```kconfig
menu "airgrep"
	config AIRGREP_USB_SERVICE_COMMANDS
		bool "USB State access and data injection commands"
		default n
		help
			Enables READ, WRITE, UPDATE_TRAFFIC, UPDATE_GNSS, LIST_TRAFFIC,
			READ_SETTINGS and WRITE_SETTINGS over USB.
			WRITE can replace arbitrary bytes within exposed component States.
			WRITE_SETTINGS replaces and removes the stored settings.
			HELLO, REBOOT and ENTER_BOOTLOADER remain available when disabled.

	config AIRGREP_TEST_TAGS
		string "Unity tags to run at boot, space separated"
		default "[adsbee] [loop] [logs] [expander] [charger] [battery] [barometer] [fusb] [buzzer]"
		help
			Tests with these tags run after boot in the test build, then the
			Unity menu opens. Empty runs nothing and opens the menu directly.

	config AIRGREP_HWTEST
		bool "Hardware test mode"
		default n
		help
			Boots the normal loop, then runs the hardware checks and prints
			one "HWTEST <name> PASS|FAIL <detail>" line per check.

	config AIRGREP_FPS_OVERLAY
		bool "Show live display statistics"
		default n

	config AIRGREP_PROFILER
		bool "LVGL draw profiler"
		default y if AIRGREP_HWTEST
		help
			Hooks the LVGL draw calls for the render_profile hardware check.
			It costs time on every draw, so release builds leave it out.

	config AIRGREP_DISPLAY
		string "Display variant"
		default ""
		help
			Directory in components/display/variants, set by the sdkconfig
			fragment in that directory. Empty builds no display and no LVGL.
			Defined here because the LVGL dependency is resolved from it in
			every build, also in those without the display component.

endmenu
```

## firmware/sdkconfig.defaults
```kconfig
#################################
# Flashing and Partitions
#################################
CONFIG_ESPTOOLPY_FLASHSIZE_16MB=y
CONFIG_PARTITION_TABLE_CUSTOM=y
CONFIG_PARTITION_TABLE_CUSTOM_FILENAME="partitions.csv"

#################################
# Logging
#################################
CONFIG_LOG_DEFAULT_LEVEL_INFO=y
CONFIG_LOG_MAXIMUM_LEVEL_DEBUG=y
CONFIG_LOG_COLORS=y
CONFIG_LOG_TAG_LEVEL_IMPL_LINKED_LIST=y

CONFIG_ESP_CONSOLE_NONE=y
CONFIG_ESP_CONSOLE_SECONDARY_NONE=y

#################################
# Service Commands
#################################
CONFIG_AIRGREP_USB_SERVICE_COMMANDS=n

#################################
# PS RAM
#################################
CONFIG_SPIRAM=y
# The 8 MB test takes 730 ms per boot, the hwtest profile runs it.
CONFIG_SPIRAM_MEMTEST=n
CONFIG_SPIRAM_ALLOW_BSS_SEG_EXTERNAL_MEMORY=y

#################################
# Serviceability
#################################
CONFIG_FREERTOS_RUN_TIME_COUNTER_TYPE_U64=y

# The event loop task is watched with the 5 s default timeout. Expiry restarts.
CONFIG_ESP_TASK_WDT_PANIC=y
# The conflict engine is many small C++ functions: built for debugging it is several times slower.

#################################
# Performance Tuning
#################################
CONFIG_COMPILER_OPTIMIZATION_PERF=y
CONFIG_PM_ENABLE=y
CONFIG_FREERTOS_USE_TICKLESS_IDLE=y
CONFIG_DAIDALUS_SINGLE_PRECISION=y
CONFIG_TINYUSB_VENDOR_COUNT=1
CONFIG_TINYUSB_VENDOR_RX_BUFSIZE=512
CONFIG_TINYUSB_VENDOR_TX_BUFSIZE=512
CONFIG_TINYUSB_VENDOR_EPSIZE=512
CONFIG_TINYUSB_DESC_USE_ESPRESSIF_VID=n
CONFIG_TINYUSB_DESC_CUSTOM_VID=0xFA00
CONFIG_TINYUSB_DESC_USE_DEFAULT_PID=n
CONFIG_TINYUSB_DESC_CUSTOM_PID=0xFA01
CONFIG_TINYUSB_DESC_MANUFACTURER_STRING="airgrep"
CONFIG_TINYUSB_DESC_PRODUCT_STRING="airgrep"
```
