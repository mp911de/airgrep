## firmware/components/board/Kconfig
```kconfig
menu "airgrep board"

    choice AIRGREP_BOARD
        prompt "Controller module"
        default AIRGREP_BOARD_PLUS

        config AIRGREP_BOARD_DISPLAY
            bool "Seeed 1.47 inch touch display (J1/J4/J9)"
        config AIRGREP_BOARD_PLUS
            bool "XIAO ESP32-S3 Plus (J2/J3)"
    endchoice

    config AIRGREP_PIN_UART_RX
        int
        default 39 if AIRGREP_BOARD_DISPLAY
        default 7 if AIRGREP_BOARD_PLUS

    config AIRGREP_PIN_UART_TX
        int
        default 40 if AIRGREP_BOARD_DISPLAY
        default 44 if AIRGREP_BOARD_PLUS

    config AIRGREP_PIN_BUZZER
        int
        default 38 if AIRGREP_BOARD_DISPLAY
        default 8 if AIRGREP_BOARD_PLUS

    config AIRGREP_PIN_SDA
        int
        default 5

    config AIRGREP_PIN_SCL
        int
        default 6

endmenu
```

## firmware/components/loop/Kconfig
```kconfig
menu "airgrep loop"

    config AIRGREP_LOOP_TICK_MS
        int "Tick period in ms"
        default 50
        range 1 1000
        help
            Longest wait of the loop task for a new event. Timeouts and
            scheduled events are checked at least this often.

    config AIRGREP_LOOP_QUEUE_DEPTH
        int "Queue depth and number of promise slots"
        default 256
        range 8 4096

    config AIRGREP_LOOP_PRIORITY
        int "Loop task priority"
        default 5
        range 1 24

    config AIRGREP_LOOP_STACK
        int "Loop task stack in bytes"
        default 8192
        range 2048 65536

    config AIRGREP_LOOP_SCHEDULED
        int "Scheduled and periodic events held at once"
        default 32
        range 1 1024

endmenu
```

## firmware/main/Kconfig.projbuild
```kconfig
menu "airgrep"

    config AIRGREP_TEST_TAGS
        string "Unity tags to run at boot, space separated"
        default "[adsbee]"
        help
            Tests with these tags run after boot in the test build, then the
            Unity menu opens. Empty runs nothing and opens the menu directly.

endmenu
```

## firmware/sdkconfig.defaults
```kconfig
CONFIG_IDF_TARGET="esp32s3"
CONFIG_ESPTOOLPY_FLASHSIZE_16MB=y
CONFIG_ESP_CONSOLE_USB_SERIAL_JTAG=y
CONFIG_LOG_DEFAULT_LEVEL_INFO=y
CONFIG_LOG_MAXIMUM_LEVEL_DEBUG=y
CONFIG_LOG_COLORS=y
CONFIG_LOG_TAG_LEVEL_IMPL_LINKED_LIST=y
CONFIG_SPIRAM=y
CONFIG_SPIRAM_MODE_OCT=y
CONFIG_FREERTOS_GENERATE_RUN_TIME_STATS=y
CONFIG_FREERTOS_RUN_TIME_STATS_USING_ESP_TIMER=y
CONFIG_FREERTOS_RUN_TIME_COUNTER_TYPE_U64=y
CONFIG_PARTITION_TABLE_CUSTOM=y
CONFIG_PARTITION_TABLE_CUSTOM_FILENAME="partitions.csv"
```
